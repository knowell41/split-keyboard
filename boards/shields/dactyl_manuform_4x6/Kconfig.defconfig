## boards/shields/dactyl_manuform_4x6/Kconfig.defconfig
```kconfig
if SHIELD_DACTYL_MANUFORM_4X6_LEFT

config ZMK_KEYBOARD_NAME
    default "Dactyl 4x6"

config ZMK_SPLIT_ROLE_CENTRAL
    default y

endif

if SHIELD_DACTYL_MANUFORM_4X6_LEFT || SHIELD_DACTYL_MANUFORM_4X6_RIGHT

config ZMK_SPLIT
    default y

endif
```

## boards/shields/dactyl_manuform_4x6/Kconfig.shield
```kconfig
config SHIELD_DACTYL_MANUFORM_4X6_LEFT
    def_bool $(shields_list_contains,dactyl_manuform_4x6_left)

config SHIELD_DACTYL_MANUFORM_4X6_RIGHT
    def_bool $(shields_list_contains,dactyl_manuform_4x6_right)
```
